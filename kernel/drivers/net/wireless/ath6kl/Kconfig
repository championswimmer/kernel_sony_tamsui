## kernel/drivers/net/wireless/ath6kl/Kconfig
```kconfig
config ATH6KL_KOBJECT
	tristate "Build ath6kl kobject -- loadable modules only"
       depends on m
	help
	  This config option will allow you to build a number of
	  different kobject sample modules showing how to use kobjects,
	  ksets, and ktypes properly.

	  If in doubt, say "N" here.
```
